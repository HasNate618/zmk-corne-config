/*
 * Left half only: column 0 (Tab/Ctrl/Shift) remapped off dead P0.31 (pin 031).
 * Solder a wire from the PCB pin-21 hole (column 0) to nano pin 009 (P0.09).
 */

&kscan0 {
	col-gpios
		= <&pro_micro 10 GPIO_ACTIVE_HIGH>
		, <&pro_micro 20 GPIO_ACTIVE_HIGH>
		, <&pro_micro 19 GPIO_ACTIVE_HIGH>
		, <&pro_micro 18 GPIO_ACTIVE_HIGH>
		, <&pro_micro 15 GPIO_ACTIVE_HIGH>
		, <&pro_micro 14 GPIO_ACTIVE_HIGH>
		;
};

/* Dead P0.31 / pro_micro 21 is shorted to GND - hog as input to avoid pull-up drain */
&gpio0 {
	p031_nc {
		gpio-hog;
		gpios = <31 GPIO_ACTIVE_HIGH>;
		input;
	};
};
